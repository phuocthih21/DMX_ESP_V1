## components/mod_net/Kconfig
```kconfig
menu "MOD_NET configuration"

config MODNET_ENABLE_W5500
    bool "Enable W5500 driver"
    default y
    help
      Enable the W5500 SPI Ethernet driver. Requires ETH SPI pins to be defined.

config MODNET_ETH_MISO_GPIO
    int "Ethernet MISO GPIO"
    default 12

config MODNET_ETH_MOSI_GPIO
    int "Ethernet MOSI GPIO"
    default 13

config MODNET_ETH_SCLK_GPIO
    int "Ethernet SCLK GPIO"
    default 14

config MODNET_ETH_CS_GPIO
    int "Ethernet CS GPIO"
    default 15

config MODNET_ETH_INT_GPIO
    int "Ethernet INT GPIO"
    default 16

config MODNET_ETH_RST_GPIO
    int "Ethernet RST GPIO"
    default 17

endmenu
```

## sdkconfig.defaults
```kconfig
CONFIG_IDF_TARGET="esp32s3"
CONFIG_ESP32S3_DEFAULT_CPU_FREQ_240=y
CONFIG_ESP32S3_DEFAULT_CPU_FREQ_MHZ=240
CONFIG_ESPTOOLPY_FLASHSIZE_16MB=y
CONFIG_COMPILER_OPTIMIZATION_PERF=y

CONFIG_SPIRAM=y
CONFIG_SPIRAM_TYPE_AUTO=y
CONFIG_SPIRAM_MODE_OCT=y
CONFIG_SPIRAM_SPEED_80M=y
CONFIG_SPIRAM_BOOT_INIT=y
CONFIG_SPIRAM_MALLOC_RESERVE_INTERNAL=32768
CONFIG_SPIRAM_MALLOC_ALWAYSINTERNAL=16384

CONFIG_FREERTOS_HZ=1000

CONFIG_ESP_WIFI_ENABLED=y
CONFIG_ESP_WIFI_IRAM_OPT=y
CONFIG_ESP_WIFI_RX_IRAM_OPT=y
CONFIG_ESP_WIFI_STATIC_RX_BUFFER_NUM=16
CONFIG_ESP_WIFI_DYNAMIC_RX_BUFFER_NUM=32
CONFIG_ESP_WIFI_STATIC_TX_BUFFER_NUM=16
CONFIG_ESP_WIFI_DYNAMIC_TX_BUFFER_NUM=32
CONFIG_ESP_WIFI_AMPDU_TX_ENABLED=y
CONFIG_ESP_WIFI_AMPDU_RX_ENABLED=y

CONFIG_LWIP_UDP_RECVMBOX_SIZE=32
CONFIG_LWIP_TCPIP_TASK_STACK_SIZE=4096
CONFIG_LWIP_TCPIP_TASK_AFFINITY_CPU0=y

CONFIG_ETH_USE_SPI_ETHERNET=y
CONFIG_ETH_SPI_ETHERNET_W5500=y

CONFIG_PARTITION_TABLE_CUSTOM=y
CONFIG_PARTITION_TABLE_CUSTOM_FILENAME="partitions.csv"
CONFIG_ESP_CONSOLE_UART_DEFAULT=y
CONFIG_ESP_CONSOLE_UART_BAUDRATE=115200

CONFIG_HTTPD_WS_SUPPORT=y
```
